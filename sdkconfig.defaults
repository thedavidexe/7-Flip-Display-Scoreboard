## sdkconfig.defaults
```kconfig
# BLE Configuration for Scoreboard Controller
# These settings enable NimBLE stack for iOS app communication

# Enable Bluetooth
CONFIG_BT_ENABLED=y

# Use NimBLE (lighter weight than Bluedroid)
CONFIG_BT_NIMBLE_ENABLED=y

# BLE only mode (no classic Bluetooth)
CONFIG_BTDM_CTRL_MODE_BLE_ONLY=y

# Connection settings
CONFIG_BT_NIMBLE_MAX_CONNECTIONS=1
CONFIG_BT_NIMBLE_MAX_BONDS=0

# NimBLE task settings
CONFIG_BT_NIMBLE_PINNED_TO_CORE=0

# Memory optimization
CONFIG_BT_NIMBLE_MEM_ALLOC_MODE_INTERNAL=y
```
